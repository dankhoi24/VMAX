/dts-v1/;

/ {
    model = "VMAX Test Board";
    compatible = "vmax,test";

    soc {
        #address-cells = <1>;
        #size-cells = <1>;

        uart@1000 {
            compatible = "test,uart";
            reg = <0x1000 0x100>;
            status = "okay";
        };
    };
};
